## Documentation/devicetree/bindings/media/sophgo,cv1800b-wave420l.yaml
```yaml
# SPDX-License-Identifier: (GPL-2.0 OR BSD-2-Clause)
%YAML 1.2
---
$id: http://devicetree.org/schemas/media/sophgo,cv1800b-wave420l.yaml#
$schema: http://devicetree.org/meta-schemas/core.yaml#

title: Sophgo CV1800B Wave420L video codec

maintainers: []

description:
  CV1800B integrates a Wave420L video codec block that is controlled by the
  Chips&Media V4L2 mem2mem driver.

properties:
  compatible:
    const: sophgo,cv1800b-wave420l

  reg:
    maxItems: 1

  interrupts:
    maxItems: 1

  clocks:
    minItems: 5
    maxItems: 7

  clock-names:
    minItems: 5
    maxItems: 7

  resets:
    minItems: 1
    maxItems: 3

  reset-names:
    minItems: 1
    maxItems: 3

  sram:
    $ref: /schemas/types.yaml#/definitions/phandle
    description:
      Optional SRAM region for reference data.

  sram-size:
    $ref: /schemas/types.yaml#/definitions/uint32
    description:
      Size in bytes of an internal SRAM window used when no SRAM phandle is
      provided.

  sophgo,syscon:
    $ref: /schemas/types.yaml#/definitions/phandle
    description:
      Phandle to TOP syscon used for SG2002 video codec SRAM/remap controls.

required:
  - compatible
  - reg
  - interrupts
  - clocks
  - clock-names
  - resets
  - reset-names

additionalProperties: false

examples:
  - |
    vpu: video-codec@b020000 {
        compatible = "sophgo,cv1800b-wave420l";
        reg = <0x0b020000 0x10000>;
        interrupts = <38>;
        clocks = <&clk 137>, <&clk 143>, <&clk 144>,
                 <&clk 145>, <&clk 146>, <&clk 147>, <&clk 148>;
        clock-names = "clk_axi_video_codec",
                      "clk_h265c",
                      "clk_apb_h265c",
                      "clk_vc_src0",
                      "clk_vc_src1",
                      "clk_vc_src2",
                      "clk_cfg_reg_vc";
        resets = <&rst 5>, <&rst 6>, <&rst 95>;
        reset-names = "h265c", "vipsys", "vcsys";
        sram-size = <0x19400>;
    };
```

## Documentation/devicetree/bindings/media/sophgo,sg2002-wave420l.yaml
```yaml
# SPDX-License-Identifier: (GPL-2.0 OR BSD-2-Clause)
%YAML 1.2
---
$id: http://devicetree.org/schemas/media/sophgo,sg2002-wave420l.yaml#
$schema: http://devicetree.org/meta-schemas/core.yaml#

title: Sophgo SG2002 Wave420L video codec

maintainers:
  - Nas Chung <nas.chung@chipsnmedia.com>
  - Jackson Lee <jackson.lee@chipsnmedia.com>

description:
  SG2002 integrates a Wave420L video codec block that is controlled by the
  Chips&Media V4L2 mem2mem driver.

properties:
  compatible:
    const: sophgo,sg2002-wave420l

  reg:
    maxItems: 1

  interrupts:
    maxItems: 1

  clocks:
    minItems: 7
    maxItems: 9

  clock-names:
    minItems: 7
    maxItems: 9

  resets:
    minItems: 2
    maxItems: 4

  reset-names:
    minItems: 2
    maxItems: 4

  sram:
    $ref: /schemas/types.yaml#/definitions/phandle
    description:
      Optional SRAM region for reference data.

  sram-size:
    $ref: /schemas/types.yaml#/definitions/uint32
    description:
      Size in bytes of an internal SRAM window used when no SRAM phandle is
      provided.

  sophgo,syscon:
    $ref: /schemas/types.yaml#/definitions/phandle
    description:
      Phandle to TOP syscon used for SG2002 video codec SRAM/remap controls.

required:
  - compatible
  - reg
  - interrupts
  - clocks
  - clock-names
  - resets
  - reset-names

additionalProperties: false

examples:
  - |
    vpu: video-codec@b020000 {
        compatible = "sophgo,sg2002-wave420l";
        reg = <0x0b020000 0x10000>;
        interrupts = <38>;
        clocks = <&clk 137>, <&clk 141>, <&clk 142>,
                 <&clk 143>, <&clk 144>,
                 <&clk 145>, <&clk 146>, <&clk 147>, <&clk 148>;
        clock-names = "clk_axi_video_codec",
                      "clk_h264c",
                      "clk_apb_h264c",
                      "clk_h265c",
                      "clk_apb_h265c",
                      "clk_vc_src0",
                      "clk_vc_src1",
                      "clk_vc_src2",
                      "clk_cfg_reg_vc";
        resets = <&rst 3>, <&rst 5>, <&rst 6>, <&rst 95>;
        reset-names = "h264c", "h265c", "vipsys", "vcsys";
        sram-size = <0x19400>;
    };
```

## drivers/media/platform/chips-media/wave4/Kconfig
```kconfig
# SPDX-License-Identifier: GPL-2.0
config VIDEO_WAVE4_VPU
	tristate "Chips&Media Wave4 Codec Driver"
	depends on V4L_MEM2MEM_DRIVERS
	depends on VIDEO_DEV && OF
	depends on ARCH_K3 || ARCH_SOPHGO || COMPILE_TEST
	select VIDEOBUF2_DMA_CONTIG
	select VIDEOBUF2_VMALLOC
	select V4L2_MEM2MEM_DEV
	select GENERIC_ALLOCATOR
	help
	  Chips&Media Wave4 stateful encoder and decoder driver.
	  This split is used for SG2002 Wave420L support.
	  To compile this driver as modules, choose M here: the
	  modules will be called wave4.
```
